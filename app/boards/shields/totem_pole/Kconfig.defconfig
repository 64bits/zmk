## app/boards/shields/totem_pole/Kconfig.defconfig
```kconfig
# Copyright (c) 2022 The ZMK Contributors
# SPDX-License-Identifier: MIT

if SHIELD_TOTEM_POLE_LEFT

config ZMK_KEYBOARD_NAME
    default "TOTEM_POLE"
    
config ZMK_SPLIT_ROLE_CENTRAL
    default y

endif

if SHIELD_TOTEM_POLE_LEFT || SHIELD_TOTEM_POLE_RIGHT

config ZMK_SPLIT
    default y

endif
```

## app/boards/shields/totem_pole/Kconfig.shield
```kconfig
# Copyright (c) 2022 The ZMK Contributors
# SPDX-License-Identifier: MIT

config SHIELD_TOTEM_POLE_LEFT
    def_bool $(shields_list_contains,totem_pole_left)

config SHIELD_TOTEM_POLE_RIGHT
    def_bool $(shields_list_contains,totem_pole_right)
```

## app/drivers/zephyr/dts/bindings/sensor/ibm,trackpoint.yaml
```yaml
description: Trackpoint Module

compatible: "ibm,trackpoint"

properties:
  gpios:
    type: phandle-array
    required: true
```
